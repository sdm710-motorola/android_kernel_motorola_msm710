## drivers/input/touchscreen/nt36xxx/Kconfig
```kconfig
#
# Novatek NT36xxx touchscreen driver configuration
#
config TOUCHSCREEN_NT36xxx
	bool "Novatek NT36xxx"
	default y
	help
	  Say Y here if you have a Novatek NT36xxx touchscreen connected
	  to your system.

	  If unsure, say N.

config TOUCHSCREEN_NT36xxx_ENABLE_DOUBLE_TAP
    bool "Novatek NT36xxx Double Tap"
    depends on TOUCHSCREEN_NT36xxx
    default n
    help
      Say Y here to enable NT36xxx DoubleTap Gesture.

config TOUCHSCREEN_NT36xxx_PANEL_NOTIFICATIONS
    bool "Novatek NT36xxx Panel Notifications"
    depends on TOUCHSCREEN_NT36xxx
    default n
    help
      Say Y here to enable NT36xxx Panel Notifications.
```
